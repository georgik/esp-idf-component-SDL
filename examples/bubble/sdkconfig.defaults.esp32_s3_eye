## examples/bubble/sdkconfig.defaults.esp32_s3_eye
```kconfig
# ESP32-S3 Eye Board Configuration Defaults
# Camera development board, 240x240 LCD, 8MB Flash + 8MB OCTAL PSRAM

# Board selection
CONFIG_ESP_BSP_SDL_BOARD_ESP32_S3_EYE=y
CONFIG_ESP_BSP_SDL_BOARD_NAME="ESP32-S3 Eye"

# Target and basic configuration
CONFIG_IDF_TARGET="esp32s3"
CONFIG_ESPTOOLPY_FLASHSIZE_8MB=y
CONFIG_ESP_DEFAULT_CPU_FREQ_MHZ_240=y
CONFIG_ESP_MAIN_TASK_STACK_SIZE=32000

# Memory Configuration - 8MB OCTAL PSRAM
CONFIG_SPIRAM=y
CONFIG_SPIRAM_MODE_OCT=y
CONFIG_SPIRAM_TYPE_ESPPSRAM64=y
CONFIG_SPIRAM_USE_MALLOC=y
CONFIG_SPIRAM_MALLOC_ALWAYSINTERNAL=16384
CONFIG_SPIRAM_MALLOC_RESERVE_INTERNAL=32768

# Heap allocation preferences (prefer PSRAM for large allocations)
CONFIG_HEAP_ALLOCATION_POLICY_DEFAULT=1

# PSRAM optimizations for OCTAL mode
CONFIG_SPIRAM_USE_MEMMAP=y
CONFIG_SPIRAM_ALLOW_BSS_SEG_EXTERNAL_MEMORY=y
CONFIG_SPIRAM_SPEED_80M=y

# Performance optimizations with OCTAL PSRAM
CONFIG_FREERTOS_IDLE_TIME_BEFORE_SLEEP=3

# Display-specific optimizations (240x240 circular LCD)
CONFIG_LCD_DRAW_BUFF_SIZE=8192

# Camera support (OV2640)
CONFIG_CAMERA_ENABLED=y
CONFIG_CAMERA_OV2640_SUPPORT=y

# Digital microphone support
CONFIG_DIGITAL_MICROPHONE_ENABLED=y

# Accelerometer support
CONFIG_ACCELEROMETER_ENABLED=y

# uSD card support
CONFIG_USD_CARD_ENABLED=y
```

## examples/bubble/sdkconfig.defaults.esp_bsp_devkit
```kconfig
# ESP BSP DevKit Configuration Defaults
# Basic BSP for ESP32 DevKits with LEDs and buttons only (no display)

# Board selection
CONFIG_ESP_BSP_SDL_BOARD_ESP_BSP_DEVKIT=y
CONFIG_ESP_BSP_SDL_BOARD_NAME="ESP BSP DevKit (LEDs/Buttons)"

# Target configuration - can be used with any ESP32 variant
CONFIG_IDF_TARGET="esp32s3"
CONFIG_ESPTOOLPY_FLASHSIZE_8MB=y
CONFIG_ESP_DEFAULT_CPU_FREQ_MHZ_240=y
CONFIG_ESP_MAIN_TASK_STACK_SIZE=16000

# Memory Configuration - Minimal, no display buffers needed
# CONFIG_SPIRAM is not set (many DevKits don't have PSRAM)

# Heap allocation preferences (internal RAM only)
CONFIG_HEAP_ALLOCATION_POLICY_DEFAULT=0

# Performance optimizations for limited resources
CONFIG_FREERTOS_IDLE_TIME_BEFORE_SLEEP=3
CONFIG_ESP_TASK_WDT_CHECK_IDLE_TASK_CPU0=n
CONFIG_ESP_TASK_WDT_CHECK_IDLE_TASK_CPU1=n

# No display buffers needed for DevKit BSP
CONFIG_LCD_DRAW_BUFF_SIZE=0

# ESP BSP DevKit specific settings
CONFIG_BSP_DEVKIT_ENABLED=y

# Button configuration (up to 5 buttons supported)
CONFIG_BSP_DEVKIT_BUTTON_ENABLED=y
CONFIG_BSP_DEVKIT_BUTTON_COUNT=2

# LED configuration (GPIO and RGB LEDs)
CONFIG_BSP_DEVKIT_LED_ENABLED=y
CONFIG_BSP_DEVKIT_LED_GPIO_COUNT=1
CONFIG_BSP_DEVKIT_LED_RGB_ENABLED=y
CONFIG_BSP_DEVKIT_LED_ADDRESSABLE_ENABLED=y

# File system support
CONFIG_BSP_DEVKIT_SPIFFS_ENABLED=y
CONFIG_BSP_DEVKIT_USD_ENABLED=y

# No LVGL support for basic DevKit BSP
# CONFIG_BSP_DEVKIT_LVGL_ENABLED is not set

# No display/touch support for DevKit BSP
# CONFIG_BSP_DEVKIT_DISPLAY_ENABLED is not set
# CONFIG_BSP_DEVKIT_TOUCH_ENABLED is not set
```

## examples/conway/sdkconfig.defaults.m5stack_tab5
```kconfig
# M5Stack Tab5 ESP32-P4 Configuration
# - 5-inch 1280x720 IPS display via MIPI-DSI
# - GT911 touch controller
# - 16MB Flash, 32MB PSRAM
# - ESP32-P4 dual-core RISC-V

# Board selection
CONFIG_SDL_BSP_M5STACK_TAB5=y

# BSP SDL Configuration
CONFIG_BSP_CONFIG_NO_GRAPHIC_LIB=y

CONFIG_IDF_TARGET="esp32p4"
CONFIG_ESPTOOLPY_FLASHSIZE_16MB=y
CONFIG_ESPTOOLPY_FLASHMODE_QIO=y
CONFIG_COMPILER_OPTIMIZATION_PERF=y
CONFIG_FREERTOS_HZ=1000

# PSRAM Configuration - CRITICAL for ESP32-P4 performance
# IMPORTANT: M5Stack Tab5 requires 200MHz SPIRAM speed for proper operation
# Default 20MHz is too slow and will cause display/performance issues
CONFIG_SPIRAM=y
CONFIG_SPIRAM_SPEED_200M=y
CONFIG_SPIRAM_USE_MALLOC=y
CONFIG_SPIRAM_MEMTEST=y
CONFIG_SPIRAM_MALLOC_ALWAYSINTERNAL=16384
CONFIG_SPIRAM_MALLOC_RESERVE_INTERNAL=32768
CONFIG_FREERTOS_TASK_CREATE_ALLOW_EXT_MEM=y

# Cache configuration for P4 - CRITICAL for graphics performance
CONFIG_CACHE_L2_CACHE_256KB=y
CONFIG_CACHE_L2_CACHE_LINE_128B=y

# ESP32-P4 specific features
CONFIG_IDF_EXPERIMENTAL_FEATURES=y

# Required for TTF rendering if it happens in main task
CONFIG_ESP_MAIN_TASK_STACK_SIZE=32000

# Panic behavior - halt and print stacktrace instead of rebooting
CONFIG_ESP_SYSTEM_PANIC_PRINT_HALT=y

# BSP configuration for M5Stack Tab5
# LVGL is disabled via BSP_CONFIG_NO_GRAPHIC_LIB in bsp/config.h (we're using SDL)
```

## examples/mandelbrot/sdkconfig.defaults.esp32_p4_function_ev
```kconfig
# ESP32-P4 Function EV Board Configuration Defaults
# RISC-V dual-core processor, up to 32MB PSRAM, multiple LCD support

# Board selection
CONFIG_ESP_BSP_SDL_BOARD_ESP32_P4_FUNCTION_EV=y
CONFIG_ESP_BSP_SDL_BOARD_NAME="ESP32-P4 Function EV Board"

# Target and basic configuration
CONFIG_IDF_TARGET="esp32p4"
CONFIG_ESPTOOLPY_FLASHSIZE_16MB=y
CONFIG_ESP_DEFAULT_CPU_FREQ_MHZ_400=y
CONFIG_ESP_MAIN_TASK_STACK_SIZE=32000

# Memory Configuration - Up to 32MB PSRAM
CONFIG_SPIRAM=y
CONFIG_SPIRAM_MODE_HEX=y
CONFIG_SPIRAM_TYPE_ESPPSRAM32=y
CONFIG_SPIRAM_USE_MALLOC=y
CONFIG_SPIRAM_MALLOC_ALWAYSINTERNAL=16384
CONFIG_SPIRAM_MALLOC_RESERVE_INTERNAL=32768

# Heap allocation preferences (prefer PSRAM for large allocations)
CONFIG_HEAP_ALLOCATION_POLICY_DEFAULT=1

# PSRAM optimizations for HEX mode (high performance)
CONFIG_SPIRAM_USE_MEMMAP=y
CONFIG_SPIRAM_ALLOW_BSS_SEG_EXTERNAL_MEMORY=y
CONFIG_SPIRAM_SPEED_200M=y

# Performance optimizations with large PSRAM
CONFIG_FREERTOS_IDLE_TIME_BEFORE_SLEEP=3

# Display-specific optimizations (large buffers for high resolution)
CONFIG_LCD_DRAW_BUFF_SIZE=32768

# ESP32-P4 specific features
CONFIG_PPA_ENABLE=y  # Pixel Processing Accelerator
CONFIG_MIPI_CSI_ENABLE=y  # Camera interface
CONFIG_MIPI_DSI_ENABLE=y  # Display interface
CONFIG_H264_ENCODER_ENABLE=y  # Hardware H264 encoder
```

## examples/mandelbrot/sdkconfig.defaults.esp_box_3
```kconfig
# ESP32-S3-BOX-3 Board Configuration Defaults
# OCTAL PSRAM available

# Board selection
CONFIG_ESP_BSP_SDL_BOARD_ESP_BOX_3=y
CONFIG_ESP_BSP_SDL_BOARD_NAME="ESP32-S3-BOX-3"

# Target and basic configuration
CONFIG_IDF_TARGET="esp32s3"
CONFIG_ESPTOOLPY_FLASHSIZE_16MB=y
CONFIG_ESP_DEFAULT_CPU_FREQ_MHZ_240=y
CONFIG_ESP_MAIN_TASK_STACK_SIZE=32000

# Memory Configuration - OCTAL PSRAM
CONFIG_SPIRAM=y
CONFIG_SPIRAM_MODE_OCT=y
CONFIG_SPIRAM_TYPE_ESPPSRAM64=y
CONFIG_SPIRAM_USE_MALLOC=y
CONFIG_SPIRAM_MALLOC_ALWAYSINTERNAL=16384
CONFIG_SPIRAM_MALLOC_RESERVE_INTERNAL=32768

# Heap allocation preferences (prefer PSRAM for large allocations)
CONFIG_HEAP_ALLOCATION_POLICY_DEFAULT=1

# PSRAM optimizations for OCTAL mode
CONFIG_SPIRAM_USE_MEMMAP=y
CONFIG_SPIRAM_ALLOW_BSS_SEG_EXTERNAL_MEMORY=y
CONFIG_SPIRAM_SPEED_80M=y

# Performance optimizations with OCTAL PSRAM
CONFIG_FREERTOS_IDLE_TIME_BEFORE_SLEEP=3

# Display-specific optimizations (can use even larger buffers with OCTAL PSRAM)
CONFIG_LCD_DRAW_BUFF_SIZE=16384

# Audio support (ESP32-S3-BOX-3 has audio codec)
CONFIG_AUDIO_BOARD_ESP32_S3_BOX_3=y
```

## examples/mandelbrot/sdkconfig.defaults.m5_atom_s3
```kconfig
# M5 Atom S3 Board Configuration Defaults
# No PSRAM available on M5 Atom S3

# Board selection
CONFIG_SDL_BSP_M5_ATOM_S3=y
CONFIG_IDF_TARGET="esp32s3"

# ESP32-S3 specific settings
CONFIG_ESPTOOLPY_FLASHSIZE_8MB=y
CONFIG_ESP_DEFAULT_CPU_FREQ_MHZ_240=y
CONFIG_COMPILER_OPTIMIZATION_PERF=y
CONFIG_FREERTOS_HZ=1000

# Memory Configuration - No PSRAM on M5 Atom S3
# CONFIG_SPIRAM is not set

# Heap allocation preferences (prefer internal RAM since no PSRAM)
CONFIG_HEAP_ALLOCATION_POLICY_DEFAULT=0

# Performance optimizations for limited RAM
CONFIG_FREERTOS_IDLE_TIME_BEFORE_SLEEP=3
CONFIG_ESP_TASK_WDT_CHECK_IDLE_TASK_CPU0=n
CONFIG_ESP_TASK_WDT_CHECK_IDLE_TASK_CPU1=n

# Display-specific optimizations
CONFIG_LCD_DRAW_BUFF_SIZE=2048
```

## examples/mandelbrot/sdkconfig.defaults.m5stack_core_s3
```kconfig
# M5Stack CoreS3 Board Configuration Defaults
# QUAD PSRAM available

# Board selection
CONFIG_SDL_BSP_M5STACK_CORE_S3=y

# Target and basic configuration
CONFIG_IDF_TARGET="esp32s3"
CONFIG_ESPTOOLPY_FLASHSIZE_16MB=y
CONFIG_ESP_DEFAULT_CPU_FREQ_MHZ_240=y
CONFIG_COMPILER_OPTIMIZATION_PERF=y
CONFIG_FREERTOS_HZ=1000
CONFIG_ESP_MAIN_TASK_STACK_SIZE=32000

# Memory Configuration - QUAD PSRAM
CONFIG_SPIRAM=y
CONFIG_SPIRAM_MODE_QUAD=y
CONFIG_SPIRAM_TYPE_ESPPSRAM64=y
CONFIG_SPIRAM_USE_MALLOC=y
CONFIG_SPIRAM_MALLOC_ALWAYSINTERNAL=16384
CONFIG_SPIRAM_MALLOC_RESERVE_INTERNAL=32768

# PSRAM optimizations
CONFIG_SPIRAM_USE_MEMMAP=y
CONFIG_SPIRAM_ALLOW_BSS_SEG_EXTERNAL_MEMORY=y

# Touch support disabled due to BSP dependency issues
# CONFIG_SDL_BSP_TOUCH_ENABLE is not set
```

## examples/snow/sdkconfig.defaults.esp32_s3_lcd_ev
```kconfig
# ESP32-S3 LCD EV Board Configuration Defaults
# Multiple LCD interface support (RGB, 8080, SPI, I2C), 16MB Flash, 8/16MB PSRAM

# Board selection
CONFIG_ESP_BSP_SDL_BOARD_ESP32_S3_LCD_EV=y
CONFIG_ESP_BSP_SDL_BOARD_NAME="ESP32-S3 LCD EV Board"

# Target and basic configuration
CONFIG_IDF_TARGET="esp32s3"
CONFIG_ESPTOOLPY_FLASHSIZE_16MB=y
CONFIG_ESP_DEFAULT_CPU_FREQ_MHZ_240=y
CONFIG_ESP_MAIN_TASK_STACK_SIZE=32000

# Memory Configuration - Up to 16MB OCTAL PSRAM
CONFIG_SPIRAM=y
CONFIG_SPIRAM_MODE_OCT=y
CONFIG_SPIRAM_TYPE_ESPPSRAM16=y
CONFIG_SPIRAM_USE_MALLOC=y
CONFIG_SPIRAM_MALLOC_ALWAYSINTERNAL=16384
CONFIG_SPIRAM_MALLOC_RESERVE_INTERNAL=32768

# Heap allocation preferences (prefer PSRAM for large allocations)
CONFIG_HEAP_ALLOCATION_POLICY_DEFAULT=1

# PSRAM optimizations for OCTAL mode
CONFIG_SPIRAM_USE_MEMMAP=y
CONFIG_SPIRAM_ALLOW_BSS_SEG_EXTERNAL_MEMORY=y
CONFIG_SPIRAM_SPEED_80M=y

# Performance optimizations with OCTAL PSRAM
CONFIG_FREERTOS_IDLE_TIME_BEFORE_SLEEP=3

# Display-specific optimizations (flexible LCD support)
CONFIG_LCD_DRAW_BUFF_SIZE=16384

# Audio support (onboard codec + amplifier)
CONFIG_AUDIO_BOARD_ESP32_S3_LCD_EV=y

# Touch and voice interaction support
CONFIG_TOUCH_INTERFACE_ENABLED=y
CONFIG_VOICE_INTERACTION_ENABLED=y
```

## examples/snow/sdkconfig.defaults.m5_atom_s3
```kconfig
# M5 Atom S3 Board Configuration Defaults
# No PSRAM available on M5 Atom S3

# Board selection
CONFIG_ESP_BSP_SDL_BOARD_M5_ATOM_S3=y
CONFIG_ESP_BSP_SDL_BOARD_NAME="M5 Atom S3"

# Memory Configuration - No PSRAM
# CONFIG_SPIRAM is not set

# Heap allocation preferences (prefer internal RAM since no PSRAM)
CONFIG_HEAP_ALLOCATION_POLICY_DEFAULT=0

# Performance optimizations for limited RAM
CONFIG_FREERTOS_IDLE_TIME_BEFORE_SLEEP=3
CONFIG_ESP_TASK_WDT_CHECK_IDLE_TASK_CPU0=n
CONFIG_ESP_TASK_WDT_CHECK_IDLE_TASK_CPU1=n

# Display-specific optimizations
CONFIG_LCD_DRAW_BUFF_SIZE=2048
```

## sdl/examples/bubble/sdkconfig.defaults.esp32_s3_korvo_2
```kconfig
# ESP32-S3 Korvo-2 Board Configuration Defaults
# Audio development board with dual microphones, LCD, camera, microSD

# Board selection
CONFIG_ESP_BSP_SDL_BOARD_ESP32_S3_KORVO_2=y
CONFIG_ESP_BSP_SDL_BOARD_NAME="ESP32-S3 Korvo-2"

# Target and basic configuration
CONFIG_IDF_TARGET="esp32s3"
CONFIG_ESPTOOLPY_FLASHSIZE_16MB=y
CONFIG_ESP_DEFAULT_CPU_FREQ_MHZ_240=y
CONFIG_ESP_MAIN_TASK_STACK_SIZE=32000

# Memory Configuration - PSRAM support
CONFIG_SPIRAM=y
CONFIG_SPIRAM_MODE_OCT=y
CONFIG_SPIRAM_TYPE_ESPPSRAM64=y
CONFIG_SPIRAM_USE_MALLOC=y
CONFIG_SPIRAM_MALLOC_ALWAYSINTERNAL=16384
CONFIG_SPIRAM_MALLOC_RESERVE_INTERNAL=32768

# Heap allocation preferences (prefer PSRAM for large allocations)
CONFIG_HEAP_ALLOCATION_POLICY_DEFAULT=1

# PSRAM optimizations for OCTAL mode
CONFIG_SPIRAM_USE_MEMMAP=y
CONFIG_SPIRAM_ALLOW_BSS_SEG_EXTERNAL_MEMORY=y
CONFIG_SPIRAM_SPEED_80M=y

# Performance optimizations with OCTAL PSRAM
CONFIG_FREERTOS_IDLE_TIME_BEFORE_SLEEP=3

# Display-specific optimizations
CONFIG_LCD_DRAW_BUFF_SIZE=12288

# Audio features (primary focus of this board)
CONFIG_AUDIO_CODEC_ENABLED=y
CONFIG_AUDIO_AMPLIFIER_ENABLED=y
CONFIG_DUAL_MICROPHONE_ARRAY=y
CONFIG_VOICE_RECOGNITION_ENABLED=y
CONFIG_NEAR_FAR_FIELD_WAKEUP=y

# Camera support
CONFIG_CAMERA_ENABLED=y

# JPEG video stream processing
CONFIG_JPEG_PROCESSING_ENABLED=y

# microSD card support
CONFIG_MICROSD_CARD_ENABLED=y

# Network audio/video optimization
CONFIG_NETWORK_AV_OPTIMIZED=y
```

## sdl/examples/bubble/sdkconfig.defaults.m5stack_tab5
```kconfig
# M5Stack Tab5 ESP32-P4 Configuration
# - 5-inch 1280x720 IPS display via MIPI-DSI
# - GT911 touch controller
# - 16MB Flash, 32MB PSRAM
# - ESP32-P4 dual-core RISC-V

# Board selection
CONFIG_SDL_BSP_M5STACK_TAB5=y

# BSP SDL Configuration
CONFIG_BSP_CONFIG_NO_GRAPHIC_LIB=y

CONFIG_IDF_TARGET="esp32p4"
CONFIG_ESPTOOLPY_FLASHSIZE_16MB=y
CONFIG_ESPTOOLPY_FLASHMODE_QIO=y
CONFIG_COMPILER_OPTIMIZATION_PERF=y
CONFIG_FREERTOS_HZ=1000

# PSRAM Configuration for ESP32-P4
CONFIG_SPIRAM=y
CONFIG_SPIRAM_MODE_HEX=y
CONFIG_SPIRAM_SPEED_200M=y
CONFIG_SPIRAM_FETCH_INSTRUCTIONS=y
CONFIG_SPIRAM_RODATA=y

# ESP32-P4 specific features
CONFIG_IDF_EXPERIMENTAL_FEATURES=y

# Required for TTF rendering if it happens in main task
CONFIG_ESP_MAIN_TASK_STACK_SIZE=32000

# Panic behavior - halt and print stacktrace instead of rebooting
CONFIG_ESP_SYSTEM_PANIC_PRINT_HALT=y

# BSP configuration for M5Stack Tab5
# LVGL is disabled via BSP_CONFIG_NO_GRAPHIC_LIB in bsp/config.h (we're using SDL)
```

## sdl/examples/conway/sdkconfig.defaults.esp_bsp_generic
```kconfig
# ESP BSP Generic Configuration Defaults
# Configurable BSP for any ESP32 DevKit with custom display/touch setup

# Board selection
CONFIG_ESP_BSP_SDL_BOARD_ESP_BSP_GENERIC=y
CONFIG_ESP_BSP_SDL_BOARD_NAME="ESP BSP Generic (Configurable)"

# Target configuration - can be used with any ESP32 variant
# Default to ESP32-S3, but users can override via menuconfig
CONFIG_IDF_TARGET="esp32s3"
CONFIG_ESPTOOLPY_FLASHSIZE_16MB=y
CONFIG_ESP_DEFAULT_CPU_FREQ_MHZ_240=y
CONFIG_ESP_MAIN_TASK_STACK_SIZE=32000

# Memory Configuration - Conservative defaults, can be customized
CONFIG_SPIRAM=y
CONFIG_SPIRAM_MODE_OCT=y
CONFIG_SPIRAM_TYPE_ESPPSRAM64=y
CONFIG_SPIRAM_USE_MALLOC=y
CONFIG_SPIRAM_MALLOC_ALWAYSINTERNAL=16384
CONFIG_SPIRAM_MALLOC_RESERVE_INTERNAL=32768

# Heap allocation preferences 
CONFIG_HEAP_ALLOCATION_POLICY_DEFAULT=1

# PSRAM optimizations
CONFIG_SPIRAM_USE_MEMMAP=y
CONFIG_SPIRAM_ALLOW_BSS_SEG_EXTERNAL_MEMORY=y
CONFIG_SPIRAM_SPEED_80M=y

# Performance optimizations
CONFIG_FREERTOS_IDLE_TIME_BEFORE_SLEEP=3

# Display-specific optimizations (conservative default)
CONFIG_LCD_DRAW_BUFF_SIZE=8192

# ESP BSP Generic specific settings
CONFIG_BSP_GENERIC_ENABLED=y

# Default GPIO assignments (commonly used pins, user configurable)
# These can be changed via menuconfig -> Component config -> BSP Generic

# Display configuration defaults
CONFIG_BSP_GENERIC_DISPLAY_ENABLED=y
CONFIG_BSP_GENERIC_DISPLAY_SPI=y
CONFIG_BSP_GENERIC_DISPLAY_ST7789=y  # Popular display choice
CONFIG_BSP_GENERIC_DISPLAY_WIDTH=240
CONFIG_BSP_GENERIC_DISPLAY_HEIGHT=320

# Touch configuration defaults (optional)
CONFIG_BSP_GENERIC_TOUCH_ENABLED=y
CONFIG_BSP_GENERIC_TOUCH_I2C=y

# Button configuration (up to 5 buttons supported)
CONFIG_BSP_GENERIC_BUTTON_ENABLED=y
CONFIG_BSP_GENERIC_BUTTON_COUNT=2

# LED configuration
CONFIG_BSP_GENERIC_LED_ENABLED=y
CONFIG_BSP_GENERIC_LED_GPIO_COUNT=1
CONFIG_BSP_GENERIC_LED_RGB_ENABLED=y

# File system support
CONFIG_BSP_GENERIC_SPIFFS_ENABLED=y
CONFIG_BSP_GENERIC_USD_ENABLED=y

# LVGL support (enabled for Generic BSP)
CONFIG_BSP_GENERIC_LVGL_ENABLED=y
```
